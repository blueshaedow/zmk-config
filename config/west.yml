## config/west.yml
```yaml
manifest:
  remotes:
    #- name: zmkfirmware
    #  url-base: https://github.com/zmkfirmware
    - name: infused-kim
      url-base: https://github.com/infused-kim
    - name: petejohanson
      url-base: https://github.com/petejohanson
    - name: urob
      url-base: https://github.com/urob
    - name: blueshaedow
      url-base: https://github.com/blueshaedow
  projects:
    # official ZMK 
    - name: zmk
      remote: urob
      revision: main
      import: app/west.yml

    # own branch
    #- name: zmk
    #  remote: blueshaedow
    #  revision: main
    #  import: app/west.yml

    # urob's branch
    #- name: zmk
    #  remote: urob
    #  revision: main
    #  import: app/west.yml

  self:
    path: config
```
